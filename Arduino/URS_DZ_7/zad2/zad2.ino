// pohrana podataka u FLASH memoriji

const uint8_t FontA[256][8] PROGMEM = {
  {0x00, 0x00, 0x00, 0x00, 0x00, 0x00, 0x00, 0x00},
  {0x7E, 0x81, 0xA5, 0x81, 0xBD, 0x99, 0x81, 0x7E},
  {0x7E, 0xFF, 0xDB, 0xFF, 0xC3, 0xE7, 0xFF, 0x7E},
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  {0x00, 0x00, 0x00, 0x00, 0x00, 0x00, 0x00, 0x00}
};

#define OP_NOOP   0
#define OP_DIGIT0 1
#define OP_DIGIT1 2
#define OP_DIGIT2 3
#define OP_DIGIT3 4
#define OP_DIGIT4 5
#define OP_DIGIT5 6
#define OP_DIGIT6 7
#define OP_DIGIT7 8
#define OP_DECODEMODE  9
#define OP_INTENSITY   10
#define OP_SCANLIMIT   11
#define OP_SHUTDOWN    12
#define OP_DISPLAYTEST 15
#define ADC1 A1
#define button1 A2
#define button2 A3


int CLK = 5; // 5 = PD5
int LOAD = 6; // 6 = PD6
int DIN = 7; // 7 = PD7

byte znak[2][8] =
{ {0xFE, 0x62, 0x68, 0x78, 0x68, 0x62, 0xFE, 0x00},
  {0x1C, 0x3C, 0x6C, 0xCC, 0xFE, 0x0C, 0x1E, 0x00}
};

byte dot = 0x08;
byte counter = 0;
unsigned long last_millis_display;
byte button_last_state = 1;
unsigned long last_millis_button;

void sendData( byte address, byte data)
{
  byte packet[2];
  byte bitmask;
  byte i;
  packet[0] = address;
  packet[1] = data;

  for (i = 0; i < 2; i++)
    for ( bitmask = 0x80 ; bitmask != 0 ; bitmask = bitmask >> 1 )
    {
      if (bitmask & packet[i]) digitalWrite(DIN, 1);
      else digitalWrite(DIN, 0);

      digitalWrite(CLK, HIGH);
      digitalWrite(CLK, LOW);
    }
  digitalWrite(LOAD, HIGH);
  digitalWrite(LOAD, LOW);
}

void setup() {
  // put your setup code here, to run once:
  pinMode(DIN, OUTPUT);
  pinMode(CLK, OUTPUT);
  pinMode(LOAD, OUTPUT);
  digitalWrite(LOAD, LOW);
  pinMode(button1, INPUT_PULLUP);
  pinMode(button2, INPUT_PULLUP);
  pinMode(ADC1, INPUT);
  Serial.begin(9600);

last_millis_display = millis();
last_millis_button = millis();

  sendData(OP_DISPLAYTEST, 0);
  sendData(OP_INTENSITY, 0);
  sendData(OP_SCANLIMIT, 7);

  sendData(OP_DECODEMODE, 0);
  sendData(OP_SHUTDOWN, 1);
  for (int i = 0; i < 8; i++) sendData(i + 1, 0b00000000);

}
const uint8_t Svjetlina[9][8] PROGMEM = {
  {0x0, 0x0, 0x0, 0x0, 0x0, 0x0, 0x0, 0x00},
  {0x0, 0x0, 0x0, 0x0, 0x0, 0x0, 0x0, 0xff},
  {0x0, 0x0, 0x0, 0x0, 0x0, 0x0, 0xff, 0xff},
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  {0xff, 0xff, 0xff, 0xff, 0xff, 0xff, 0xff, 0xff}
};

byte tipkalo_zadnje_stanje1 = 1;
int checkBt1()
{
  if ( digitalRead(button1) == 0 && tipkalo_zadnje_stanje1 == 1)
  {
    delay(25);
    tipkalo_zadnje_stanje1 = 0;
    return 1;
  }

  if (digitalRead(button1) == 1 && tipkalo_zadnje_stanje1 == 0)
  {
    delay(25);
    tipkalo_zadnje_stanje1 = 1;
  }
  return 0;
}

byte tipkalo_zadnje_stanje2 = 1;
int checkBt2()
{
  if ( digitalRead(button2) == 0 && tipkalo_zadnje_stanje2 == 1)
  {
    delay(25);
    tipkalo_zadnje_stanje2 = 0;
    return 1;
  }

  if (digitalRead(button2) == 1 && tipkalo_zadnje_stanje2 == 0)
  {
    delay(25);
    tipkalo_zadnje_stanje2 = 1;
  }
  return 0;
}



void loop() {
  // put your main code here, to run repeatedly:
  
    if (checkBt1())
    {

      dot = dot << 1;
      if (dot == 0)
      {
        counter = 0;
        dot = 0x08;

      }
    }

    if (checkBt2())
    {

      dot = dot >> 1;
      if (dot == 0)
      {
        counter = 0;
        dot = 0x08;

      }
    }

  if (millis() - last_millis_display > 200)
  {
    for (int i = 0; i < 8; i++)
    {
      if (i == counter) sendData(i + 1, dot);
      else sendData(i + 1, 0);
    }
    last_millis_display = millis();

    counter++;
    if (counter >= 8) counter = 0;

  }


  
  }





